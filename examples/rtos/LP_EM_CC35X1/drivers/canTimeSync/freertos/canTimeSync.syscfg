/*
 * Copyright (c) 2024-2026, Texas Instruments Incorporated
 * All rights reserved.
 *
 * Redistribution and use in source and binary forms, with or without
 * modification, are permitted provided that the following conditions
 * are met:
 *
 * *  Redistributions of source code must retain the above copyright
 *    notice, this list of conditions and the following disclaimer.
 *
 * *  Redistributions in binary form must reproduce the above copyright
 *    notice, this list of conditions and the following disclaimer in the
 *    documentation and/or other materials provided with the distribution.
 *
 * *  Neither the name of Texas Instruments Incorporated nor the names of
 *    its contributors may be used to endorse or promote products derived
 *    from this software without specific prior written permission.
 *
 * THIS SOFTWARE IS PROVIDED BY THE COPYRIGHT HOLDERS AND CONTRIBUTORS "AS IS"
 * AND ANY EXPRESS OR IMPLIED WARRANTIES, INCLUDING, BUT NOT LIMITED TO,
 * THE IMPLIED WARRANTIES OF MERCHANTABILITY AND FITNESS FOR A PARTICULAR
 * PURPOSE ARE DISCLAIMED. IN NO EVENT SHALL THE COPYRIGHT OWNER OR
 * CONTRIBUTORS BE LIABLE FOR ANY DIRECT, INDIRECT, INCIDENTAL, SPECIAL,
 * EXEMPLARY, OR CONSEQUENTIAL DAMAGES (INCLUDING, BUT NOT LIMITED TO,
 * PROCUREMENT OF SUBSTITUTE GOODS OR SERVICES; LOSS OF USE, DATA, OR PROFITS;
 * OR BUSINESS INTERRUPTION) HOWEVER CAUSED AND ON ANY THEORY OF LIABILITY,
 * WHETHER IN CONTRACT, STRICT LIABILITY, OR TORT (INCLUDING NEGLIGENCE OR
 * OTHERWISE) ARISING IN ANY WAY OUT OF THE USE OF THIS SOFTWARE,
 * EVEN IF ADVISED OF THE POSSIBILITY OF SUCH DAMAGE.
 */
// @cliArgs --board /ti/boards/LP_EM_CC35X1 --rtos freertos

/*
 *  canTimeSync.syscfg
 */

const board = system.deviceData.board.name;

/* ======== Kernel Configuration ======== */
system.getScript("kernel_config_release.syscfg.js");

/* ======== CAN ======== */
const CAN    = scripting.addModule("/ti/drivers/CAN");
const GPIO   = scripting.addModule("/ti/drivers/GPIO");
const CAN1   = CAN.addInstance();
CAN1.nomBitRate        = 500000;
if( !board.match(/CC35/) )
{
    /*
    *   CC35xx has DCAN peripheral which only supports CAN2.0B and not CAN-FD.
    *   canFDEnable, brsEnable & dataBitRate are valid options for CAN peripherals
    *   which support CAN-FD and so it is excluded for CC35xx devices.
    */

    CAN1.canFDEnable       = true;
    CAN1.brsEnable         = true;
    CAN1.dataBitRate       = 1000000;
}
CAN1.txRingBufferSize  = 0;
CAN1.rxRingBufferSize  = 6;
CAN1.rejectNonMatching = false;
CAN1.interruptPriority = "4";
CAN1.$hardware = system.deviceData.board.components.LP_CAN_BUS;

if( board.match(/CC27/) || board.match(/CC23/) )
{
    CAN1.taskStackSize = 2048;
}

/* ======== GPIO ======== */
const Button   = scripting.addModule("/ti/drivers/apps/Button");

const Button1  = Button.addInstance();
Button1.$name     = "CONFIG_BUTTON_0";
Button1.$hardware = system.deviceData.board.components["BTN-1"];

const Button2  = Button.addInstance();
Button2.$name     = "CONFIG_BUTTON_1";
Button2.$hardware = system.deviceData.board.components["BTN-2"];

if( !board.match(/CC35/) )
{
/*
*   In LP_EM_CC35X1 launchpad, GPIO30 is connected to LED_GREEN and GPIO34 is
*   connected to LED_RED. Also, GPIO30 is connected to DCAN_TX and GPIO34 is
*   is connected to DCAN_RX. Hence LED_GREEN and LED_RED cannot be controlled using
*   GPIO30 and GPIO34 and they are disabled for LP_EM_CC35X1.
*/
var gpio2 = GPIO.addInstance();
gpio2.$hardware = system.deviceData.board.components.LED_RED;
gpio2.$name = "CONFIG_GPIO_LED_0";

var gpio3 = GPIO.addInstance();
gpio3.$hardware = system.deviceData.board.components.LED_GREEN;
gpio3.$name = "CONFIG_GPIO_LED_1";

}

/* ======== UART2 ======== */
const UART2    = scripting.addModule("/ti/drivers/UART2");
const UART21   = UART2.addInstance();
UART21.$hardware        = system.deviceData.board.components.XDS110UART;
UART21.txRingBufferSize = 2048;
