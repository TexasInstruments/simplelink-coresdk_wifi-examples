/*
 * Copyright (c) 2018-2025, Texas Instruments Incorporated
 * All rights reserved.
 *
 * Redistribution and use in source and binary forms, with or without
 * modification, are permitted provided that the following conditions
 * are met:
 *
 * *  Redistributions of source code must retain the above copyright
 *    notice, this list of conditions and the following disclaimer.
 *
 * *  Redistributions in binary form must reproduce the above copyright
 *    notice, this list of conditions and the following disclaimer in the
 *    documentation and/or other materials provided with the distribution.
 *
 * *  Neither the name of Texas Instruments Incorporated nor the names of
 *    its contributors may be used to endorse or promote products derived
 *    from this software without specific prior written permission.
 *
 * THIS SOFTWARE IS PROVIDED BY THE COPYRIGHT HOLDERS AND CONTRIBUTORS "AS IS"
 * AND ANY EXPRESS OR IMPLIED WARRANTIES, INCLUDING, BUT NOT LIMITED TO,
 * THE IMPLIED WARRANTIES OF MERCHANTABILITY AND FITNESS FOR A PARTICULAR
 * PURPOSE ARE DISCLAIMED. IN NO EVENT SHALL THE COPYRIGHT OWNER OR
 * CONTRIBUTORS BE LIABLE FOR ANY DIRECT, INDIRECT, INCIDENTAL, SPECIAL,
 * EXEMPLARY, OR CONSEQUENTIAL DAMAGES (INCLUDING, BUT NOT LIMITED TO,
 * PROCUREMENT OF SUBSTITUTE GOODS OR SERVICES; LOSS OF USE, DATA, OR PROFITS;
 * OR BUSINESS INTERRUPTION) HOWEVER CAUSED AND ON ANY THEORY OF LIABILITY,
 * WHETHER IN CONTRACT, STRICT LIABILITY, OR TORT (INCLUDING NEGLIGENCE OR
 * OTHERWISE) ARISING IN ANY WAY OUT OF THE USE OF THIS SOFTWARE,
 * EVEN IF ADVISED OF THE POSSIBILITY OF SUCH DAMAGE.
 */
// @cliArgs --board /ti/boards/LP_EM_CC35X1 --rtos freertos

/*
 *  pwmled1.syscfg
 */

/* ======== Kernel Configuration ======== */
system.getScript("kernel_config_release.syscfg.js");

/* ======== Board ======== */
var board = system.deviceData.board.name;

/* ======== PWM ======== */
var PWM = scripting.addModule("/ti/drivers/PWM");

if (board.match(/LP_EM_CC2745R10_Q1|LP_EM_CC2745R10_FPGA|LP_EM_CC2745R10_SOCKET|LP_EM_CC2745P10_SOCKET/)) {
    var pwm0 = PWM.addInstance();
    pwm0.$name                            = "CONFIG_PWM_0";
    pwm0.timerObject.channel0Connection   = "Pin";
    pwm0.timerObject.timer.$assign        = "LGPT3";
    pwm0.timerObject.timer.ch0Pin.$assign = "DIO16";

    scripting.suppress("@@@.+?@@@", pwm0.timerObject.timer, "ch0Pin");
}
else if (board.match(/LP_EM_CC2340R5/)) {
    var pwm0 = PWM.addInstance();
    pwm0.$name                            = "CONFIG_PWM_0";
    pwm0.timerObject.channel2Connection   = "Pin";
    pwm0.timerObject.timer.$assign        = "LGPT3";
    pwm0.timerObject.timer.ch2Pin.$assign = "DIO14";

    scripting.suppress("@@@.+?@@@", pwm0.timerObject.timer, "ch2Pin");
}
else if (board.match(/LP_EM_CC3561EF_FPGA/)) {
    var pwm0 = PWM.addInstance();
    pwm0.$name                            = "CONFIG_PWM_0";
    pwm0.timerObject.channel2Connection   = "Pin";
    pwm0.timerObject.timer.$assign        = "GPT1";
    pwm0.timerObject.timer.ch2Pin.$assign = "GPIO33";

    scripting.suppress("@@@.+?@@@", pwm0.timerObject.timer, "ch2Pin");
}
else if (board.match(/LP_EM_CC35X1/)) {
    var pwm0 = PWM.addInstance();
    pwm0.$name                            = "CONFIG_PWM_0";
    pwm0.timerObject.channel1Connection   = "Pin";
    pwm0.timerObject.timer.$assign        = "GPT1";
    pwm0.timerObject.timer.ch1Pin.$assign = "GPIO30";

    scripting.suppress("@@@.+?@@@", pwm0.timerObject.timer, "ch1Pin");
}
else {
    var pwm0 = PWM.addInstance();
    pwm0.$hardware = system.deviceData.board.components.LED0_PWM;
    pwm0.$name = "CONFIG_PWM_0";
}
